/dts-v1/;
/plugin/;

&bcm2711_pinctrl {
	dht11_pins: dht11_pins {
		brcm,pins=<17>;
        brcm,function=<0>;  /*BCM2835_FSEL_GPIO_IN*/
        brcm,pull=<2>;  /*BCM2835_PUD_UP*/
	};
};

/ {
    compatible = "brcm,bcm2835";
    
    // The device node for your sensor
    fragment@0 {
        target-path = "/";
        
        __overlay__ {
            dht11_sensor: dht11_sensor {
                compatible = "dht11,sensor";
                pinctrl-names = "default";
                pinctrl-0 = <&dht11_pins>;
				gpios = <&gpio 17 1>;
            };
        };
    };
};
